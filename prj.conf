## CMakeLists.txt
```
#
# Copyright (c) 2025 Nordic Semiconductor ASA
#
# SPDX-License-Identifier: LicenseRef-Nordic-5-Clause
#

cmake_minimum_required(VERSION 3.20.0)
set(APPVERSION "1.0.0")

find_package(Zephyr HINTS $ENV{ZEPHYR_BASE})

project(water_sensor)

# Enable GNU STD support.
include(${ZEPHYR_CONNECTEDHOMEIP_MODULE_DIR}/config/nrfconnect/app/enable-gnu-std.cmake)

# NORDIC SDK APP START

# Include all source files that are located in the Matter common directory.
include(${ZEPHYR_NRF_MODULE_DIR}/samples/matter/common/cmake/source_common.cmake)

# Include Data Model utils
include(${ZEPHYR_NRF_MODULE_DIR}/samples/matter/common/cmake/data_model.cmake)

include(${ZEPHYR_NRF_MODULE_DIR}/samples/matter/common/cmake/zap_helpers.cmake)
ncs_get_zap_parent_dir(ZAP_PARENT_DIR)

target_include_directories(app PRIVATE
  src
  ${ZAP_PARENT_DIR}
)

target_sources(app PRIVATE
 src/app_task.cpp
  src/main.cpp
)

ncs_configure_data_model()
# NORDIC SDK APP END
```

## prj.conf
```kconfig
# Matter core
CONFIG_CHIP=y
CONFIG_CHIP_PROJECT_CONFIG="src/chip_project_config.h"
CONFIG_STD_CPP17=y

# Device identity
CONFIG_CHIP_DEVICE_PRODUCT_NAME="Water Leak Sensor"
CONFIG_CHIP_DEVICE_VENDOR_NAME="DJ Tech"
CONFIG_CHIP_DEVICE_SERIAL_NUMBER="12234545"
CONFIG_CHIP_DEVICE_SOFTWARE_VERSION=1
CONFIG_CHIP_DEVICE_SOFTWARE_VERSION_STRING="1.0.0"
CONFIG_CHIP_DEVICE_HARDWARE_VERSION=1
CONFIG_CHIP_DEVICE_HARDWARE_VERSION_STRING="1.0.0"
CONFIG_CHIP_DEVICE_VENDOR_ID=65521
CONFIG_BT_DEVICE_NAME="MatterWater"

# ZAP
CONFIG_NCS_SAMPLE_MATTER_ZAP_FILE_PATH="${APPLICATION_CONFIG_DIR}/src/default_zap/water_sensor.zap"

# Commissioning
CONFIG_CHIP_ENABLE_PAIRING_AUTOSTART=y
CONFIG_CHIP_BLE_EXT_ADVERTISING=n
CONFIG_CHIP_BLE_ADVERTISING_DURATION=15

# Drivers
CONFIG_GPIO=y
CONFIG_ADC=y
CONFIG_DK_LIBRARY=y

# Power management
CONFIG_PM_DEVICE=y
CONFIG_PM_DEVICE_RUNTIME=y
CONFIG_RAM_POWER_DOWN_LIBRARY=y

# Disable LEDs via Kconfig
CONFIG_NCS_SAMPLE_MATTER_LEDS=n

# OpenThread MTD settings
CONFIG_OPENTHREAD_NORDIC_LIBRARY_MTD=y
CONFIG_OPENTHREAD_MTD=y
CONFIG_OPENTHREAD_FTD=n
CONFIG_OPENTHREAD_MTD_SED=y

# Child timeouts - must be larger than slow poll interval
# Slow poll is 30000ms so set these well above that
CONFIG_OPENTHREAD_MLE_CHILD_TIMEOUT=1200
CONFIG_OPENTHREAD_CHILD_SUPERVISION_CHECK_TIMEOUT=1200
CONFIG_OPENTHREAD_CHILD_SUPERVISION_INTERVAL=1200

# ICD - Long Idle Time device
CONFIG_CHIP_ENABLE_ICD_SUPPORT=y
CONFIG_CHIP_ICD_LIT_SUPPORT=y
CONFIG_CHIP_ICD_CHECK_IN_SUPPORT=y
CONFIG_CHIP_ICD_UAT_SUPPORT=y

# LIT requires slow poll > 15000ms
CONFIG_CHIP_ICD_FAST_POLLING_INTERVAL=500
CONFIG_CHIP_ICD_IDLE_MODE_DURATION=3600
CONFIG_CHIP_ICD_ACTIVE_MODE_DURATION=5000
CONFIG_CHIP_ICD_ACTIVE_MODE_THRESHOLD=5000
CONFIG_CHIP_ICD_REPORT_ON_ACTIVE_MODE=y
CONFIG_CHIP_ICD_SLOW_POLL_INTERVAL=60000




# Disable SSED - conflicts with LIT
CONFIG_CHIP_THREAD_SSED=n

# Disable unused features
CONFIG_CHIP_OTA_REQUESTOR=n
CONFIG_CHIP_NFC_ONBOARDING_PAYLOAD=n
CONFIG_CHIP_FACTORY_DATA=n
CONFIG_CHIP_FACTORY_DATA_BUILD=n
CONFIG_BOOTLOADER_MCUBOOT=n
CONFIG_DFU_MULTI_IMAGE=n
CONFIG_DFU_TARGET=n
CONFIG_DFU_TARGET_MCUBOOT=n

# Disable debug features i have put y because to find any errors and to commission it
CONFIG_CHIP_LIB_SHELL=y
CONFIG_SHELL=y
CONFIG_LOG=y
CONFIG_PRINTK=y
CONFIG_SERIAL=y
CONFIG_UART_CONSOLE=y
CONFIG_CONSOLE=y
CONFIG_USE_SEGGER_RTT=y
CONFIG_RESET_ON_FATAL_ERROR=n

# Power saving extras
CONFIG_ASSERT_VERBOSE=n
CONFIG_ASSERT_NO_FILE_INFO=y
CONFIG_THREAD_NAME=n
CONFIG_BOOT_BANNER=n
CONFIG_LTO=y
CONFIG_ISR_TABLES_LOCAL_DECLARATION=y
CONFIG_NCS_SAMPLE_MATTER_WATCHDOG=y
```

## src/main.cpp
```c
#include "app_task.h"
#include <zephyr/logging/log.h>

LOG_MODULE_REGISTER(app, CONFIG_CHIP_APP_LOG_LEVEL);

int main()
{
    CHIP_ERROR err = AppTask::Instance().StartApp();
    return err == CHIP_NO_ERROR ? EXIT_SUCCESS : EXIT_FAILURE;
}
```

## src/app_task.cpp
```c
#include "app_task.h"
#include "app/matter_init.h"
#include "app/task_executor.h"
#include "board/board.h"
#include <zephyr/logging/log.h>
#include <zephyr/drivers/gpio.h>
#include <zephyr/drivers/adc.h>
#include <zephyr/kernel.h>
#include <app-common/zap-generated/attributes/Accessors.h>
#include <platform/CHIPDeviceEvent.h>

LOG_MODULE_DECLARE(app, CONFIG_CHIP_APP_LOG_LEVEL);

using namespace ::chip;
using namespace ::chip::app;
using namespace ::chip::DeviceLayer;

/* Debounce time in milliseconds */
#define DEBOUNCE_MS 50

/* Sensors */
static const struct gpio_dt_spec s0 = GPIO_DT_SPEC_GET(DT_ALIAS(sw0), gpios);
static const struct gpio_dt_spec s1 = GPIO_DT_SPEC_GET(DT_ALIAS(sw1), gpios);

/* GPIO callbacks */
static struct gpio_callback s0_cb_data;
static struct gpio_callback s1_cb_data;

/* Debounce timestamps */
static int64_t s0_last_trigger = 0;
static int64_t s1_last_trigger = 0;

/* Timer */
static struct k_timer sBatteryTimer;

/* ADC */
static const struct device *adc_dev;
static int16_t adc_sample;

static struct adc_channel_cfg vdd_channel_cfg = {
    .gain             = ADC_GAIN_1_6,
    .reference        = ADC_REF_INTERNAL,
    .acquisition_time = ADC_ACQ_TIME_DEFAULT,
    .channel_id       = 0,
    .input_positive   = SAADC_CH_PSELP_PSELP_VDD,
};

static struct adc_sequence adc_sequence = {
    .channels    = BIT(0),
    .buffer      = &adc_sample,
    .buffer_size = sizeof(adc_sample),
    .resolution  = 12,
};

/* ---------------------------------------------------------- */
/* Battery                                                      */
/* ---------------------------------------------------------- */

static uint16_t read_battery_mv()
{
    if (!adc_dev) return 0;
    adc_read(adc_dev, &adc_sequence);
    int32_t mv = (int32_t)adc_sample * 3600 / 4096;
    if (mv < 0) mv = 0;
    return (uint16_t)mv;
}

static void update_battery()
{
    uint16_t v_mv = read_battery_mv();
    uint8_t pct = 0;

    if (v_mv >= 3000)      pct = 200;
    else if (v_mv <= 2000) pct = 0;
    else                   pct = (uint8_t)((v_mv - 2000) * 200 / 1000);

    chip::app::Clusters::PowerSource::Attributes::BatVoltage::Set(0, v_mv);
    chip::app::Clusters::PowerSource::Attributes::BatPercentRemaining::Set(0, pct);
}

/* ---------------------------------------------------------- */
/* Sensor state report                                         */
/* ---------------------------------------------------------- */

static void report_sensor_states()
{
    /* Sensor 1 - normal logic */
    /* Open = dry, Closed = wet */
    chip::app::Clusters::BooleanState::Attributes::StateValue::Set(
        1, gpio_pin_get_dt(&s0) > 0);

    /* Sensor 2 - to have inverted logic (&s1) == 0); */
    chip::app::Clusters::BooleanState::Attributes::StateValue::Set(
        2, gpio_pin_get_dt(&s1) > 0);
}

/* ---------------------------------------------------------- */
/* Matter event handler                                        */
/* ---------------------------------------------------------- */

static void MatterEventHandler(const ChipDeviceEvent *event, intptr_t arg)
{
    Nrf::Board::DefaultMatterEventHandler(event, arg);

    switch (event->Type)
    {
    case DeviceEventType::kThreadConnectivityChange:
        if (event->ThreadConnectivityChange.Result == kConnectivity_Established)
        {
            /* Turn off LED via board library */
            Nrf::GetBoard().GetLED(Nrf::DeviceLeds::LED1).Set(false);

            /* Report current states */
            report_sensor_states();
            update_battery();
        }
        break;

    case DeviceEventType::kCHIPoBLEAdvertisingChange:
        /* Turn off LED after BLE advertising stops */
        if (!event->CHIPoBLEAdvertisingChange.Result)
        {
            Nrf::GetBoard().GetLED(Nrf::DeviceLeds::LED1).Set(false);
        }
        break;

    default:
        break;
    }
}

/* ---------------------------------------------------------- */
/* Sensor interrupts with debounce                             */
/* ---------------------------------------------------------- */

static void sensor0_changed(const struct device *dev,
                             struct gpio_callback *cb, uint32_t pins)
{
    int64_t now = k_uptime_get();
    if (now - s0_last_trigger < DEBOUNCE_MS) return;
    s0_last_trigger = now;

    Nrf::PostTask([] {
        /* Sensor 1 - normal logic */
        /* Open = dry, Closed = wet */
        int val = gpio_pin_get_dt(&s0);
        
        /* below is inverted logic but i am just reversing the float 
            chip::app::Clusters::BooleanState::Attributes::StateValue::Set(1, val == 0); it could also be done Set(2, !val); */
        chip::app::Clusters::BooleanState::Attributes::StateValue::Set(1, val > 0);
    });
}

static void sensor1_changed(const struct device *dev,
                             struct gpio_callback *cb, uint32_t pins)
{
    int64_t now = k_uptime_get();
    if (now - s1_last_trigger < DEBOUNCE_MS) return;
    s1_last_trigger = now;

    Nrf::PostTask([] {
        /* Sensor 2 - inverted logic (physically reversed reed switch) */
        /* Open = wet, Closed = dry - both open = low power */
        int val = gpio_pin_get_dt(&s1);
        chip::app::Clusters::BooleanState::Attributes::StateValue::Set(2, val > 0);
    });
}

/* ---------------------------------------------------------- */
/* Timer callbacks                                             */
/* ---------------------------------------------------------- */

static void BatteryTimerCallback(k_timer *timer)
{
    Nrf::PostTask([] { update_battery(); });
}

/* ---------------------------------------------------------- */
/* AppTask                                                     */
/* ---------------------------------------------------------- */

CHIP_ERROR AppTask::Init()
{
    ReturnErrorOnFailure(Nrf::Matter::PrepareServer());

    if (!Nrf::GetBoard().Init()) {
        LOG_ERR("User interface initialization failed.");
        return CHIP_ERROR_INCORRECT_STATE;
    }

    /* Register our event handler */
    ReturnErrorOnFailure(Nrf::Matter::RegisterEventHandler(
        MatterEventHandler, 0));

    /* Configure sensor GPIOs */
    gpio_pin_configure_dt(&s0, GPIO_INPUT);
    gpio_pin_configure_dt(&s1, GPIO_INPUT);

    /* Configure interrupts on both edges */
    gpio_pin_interrupt_configure_dt(&s0, GPIO_INT_EDGE_BOTH);
    gpio_pin_interrupt_configure_dt(&s1, GPIO_INT_EDGE_BOTH);

    /* Register GPIO callbacks */
    gpio_init_callback(&s0_cb_data, sensor0_changed, BIT(s0.pin));
    gpio_init_callback(&s1_cb_data, sensor1_changed, BIT(s1.pin));
    gpio_add_callback(s0.port, &s0_cb_data);
    gpio_add_callback(s1.port, &s1_cb_data);

    /* Init ADC */
    adc_dev = DEVICE_DT_GET(DT_NODELABEL(adc));
    if (device_is_ready(adc_dev)) {
        adc_channel_setup(adc_dev, &vdd_channel_cfg);
    } else {
        adc_dev = nullptr;
    }

    /* Battery update every 6 hours */
    k_timer_init(&sBatteryTimer, BatteryTimerCallback, nullptr);
    k_timer_start(&sBatteryTimer, K_HOURS(6), K_HOURS(6));

    return Nrf::Matter::StartServer();
}

CHIP_ERROR AppTask::StartApp()
{
    ReturnErrorOnFailure(Init());
    while (true) {
        Nrf::DispatchNextTask();
    }
    return CHIP_NO_ERROR;
}
```

## src/app_task.h
```c
#pragma once
#include <lib/core/CHIPError.h>

class AppTask {
public:
    static AppTask &Instance()
    {
        static AppTask sAppTask;
        return sAppTask;
    }
    CHIP_ERROR StartApp();

private:
    CHIP_ERROR Init();
};
```
